## conf/layer.conf
```bitbake
# We have a conf and classes directory, add to BBPATH
BBPATH .= ":${LAYERDIR}"

# We have recipes-* directories, add to BBFILES
BBFILES += "${LAYERDIR}/recipes-*/*/*.bb \
            ${LAYERDIR}/recipes-*/*/*.bbappend"

BBFILE_COLLECTIONS += "meta-quickdemo"
BBFILE_PATTERN_meta-quickdemo = "^${LAYERDIR}/"
BBFILE_PRIORITY_meta-quickdemo = "6"

LAYERDEPENDS_meta-quickdemo = "core"
LAYERSERIES_COMPAT_meta-quickdemo = "kirkstone langdale"
```
